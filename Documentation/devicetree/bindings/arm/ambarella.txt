## arch/arm64/configs/ambarella_cv5_defconfig
```kconfig
# CONFIG_LOCALVERSION_AUTO is not set
CONFIG_DEFAULT_HOSTNAME="Ambarella"
CONFIG_SYSVIPC=y
CONFIG_POSIX_MQUEUE=y
CONFIG_USELIB=y
CONFIG_NO_HZ_IDLE=y
CONFIG_HIGH_RES_TIMERS=y
CONFIG_PREEMPT=y
CONFIG_BSD_PROCESS_ACCT=y
CONFIG_BSD_PROCESS_ACCT_V3=y
CONFIG_IKCONFIG=y
CONFIG_IKCONFIG_PROC=y
CONFIG_LOG_BUF_SHIFT=16
CONFIG_CGROUP_HUGETLB=y
# CONFIG_UTS_NS is not set
# CONFIG_IPC_NS is not set
CONFIG_SCHED_AUTOGROUP=y
CONFIG_BLK_DEV_INITRD=y
# CONFIG_PERF_EVENTS is not set
# CONFIG_COMPAT_BRK is not set
CONFIG_PROFILING=y
CONFIG_ARCH_AMBARELLA=y
CONFIG_NR_CPUS=2
CONFIG_HZ_1000=y
CONFIG_COMPAT=y
CONFIG_CMDLINE="console=ttyS0"
# CONFIG_EFI is not set
CONFIG_ARM64_CRYPTO=y
CONFIG_CRYPTO_SHA1_ARM64_CE=y
CONFIG_CRYPTO_SHA2_ARM64_CE=y
CONFIG_CRYPTO_GHASH_ARM64_CE=y
CONFIG_CRYPTO_AES_ARM64_CE_CCM=y
CONFIG_CRYPTO_AES_ARM64_CE_BLK=y
CONFIG_CRYPTO_AES_ARM64_NEON_BLK=y
CONFIG_JUMP_LABEL=y
# CONFIG_SECCOMP is not set
CONFIG_MODULES=y
CONFIG_MODULE_UNLOAD=y
CONFIG_BLK_DEV_BSGLIB=y
CONFIG_PARTITION_ADVANCED=y
# CONFIG_EFI_PARTITION is not set
# CONFIG_CORE_DUMP_DEFAULT_ELF_HEADERS is not set
CONFIG_CMA=y
CONFIG_NET=y
CONFIG_PACKET=y
CONFIG_UNIX=y
CONFIG_UNIX_DIAG=y
CONFIG_XFRM_USER=y
CONFIG_INET=y
CONFIG_IP_MULTICAST=y
CONFIG_IP_ADVANCED_ROUTER=y
CONFIG_IP_PNP=y
CONFIG_IP_PNP_DHCP=y
CONFIG_IP_PNP_BOOTP=y
# CONFIG_INET_DIAG is not set
# CONFIG_IPV6 is not set
CONFIG_BT=m
CONFIG_BT_RFCOMM=m
CONFIG_BT_RFCOMM_TTY=y
CONFIG_BT_BNEP=m
CONFIG_BT_BNEP_MC_FILTER=y
CONFIG_BT_BNEP_PROTO_FILTER=y
CONFIG_BT_HS=y
CONFIG_BT_HCIBTUSB=m
CONFIG_BT_HCIBTSDIO=m
CONFIG_BT_HCIUART=m
CONFIG_BT_HCIUART_H4=y
CONFIG_BT_HCIUART_BCSP=y
CONFIG_CFG80211=m
CONFIG_CFG80211_DEBUGFS=y
CONFIG_CFG80211_WEXT=y
CONFIG_MAC80211=m
CONFIG_RFKILL=m
CONFIG_PCI=y
CONFIG_PCIEPORTBUS=y
CONFIG_PCIEAER=y
CONFIG_PCI_CADENCE_AMBARELLA_HOST=y
CONFIG_PCI_CADENCE_AMBARELLA_EP=y
CONFIG_PCI_ENDPOINT=y
CONFIG_PCI_ENDPOINT_CONFIGFS=y
CONFIG_PCI_EPF_AMBA_TEST=m
CONFIG_AMBARELLA_EXCALIBUR_EP=y
CONFIG_AMBARELLA_MOEMOEKYUN_EP=y
CONFIG_UEVENT_HELPER=y
CONFIG_DEVTMPFS=y
CONFIG_DEVTMPFS_MOUNT=y
# CONFIG_STANDALONE is not set
# CONFIG_PREVENT_FIRMWARE_BUILD is not set
CONFIG_CONNECTOR=y
CONFIG_MTD=y
CONFIG_MTD_CMDLINE_PARTS=y
CONFIG_MTD_BLOCK_AMBRO=y
CONFIG_MTD_RAW_NAND=y
CONFIG_MTD_COMBO_NAND_AMBARELLA=y
CONFIG_MTD_UBI=y
CONFIG_MTD_UBI_FASTMAP=y
CONFIG_MTD_UBI_BLOCK=y
CONFIG_BLK_DEV_LOOP=y
CONFIG_BLK_DEV_RAM=y
CONFIG_BLK_DEV_RAM_COUNT=1
CONFIG_BLK_DEV_RAM_SIZE=65536
CONFIG_BLK_DEV_NVME=m
CONFIG_PCI_ENDPOINT_AMBA_TEST=m
CONFIG_SCSI=m
CONFIG_BLK_DEV_SD=m
CONFIG_MD=y
CONFIG_BLK_DEV_DM=y
CONFIG_DM_INIT=y
CONFIG_DM_VERITY=y
CONFIG_NETDEVICES=y
CONFIG_NETCONSOLE=y
CONFIG_NETCONSOLE_DYNAMIC=y
CONFIG_NET_VENDOR_AMBARELLA=m
CONFIG_NET_VENDOR_AMBARELLA_INTEN_TUE=y
# CONFIG_NET_VENDOR_AMD is not set
CONFIG_AQTION=m
# CONFIG_NET_VENDOR_ARC is not set
# CONFIG_NET_VENDOR_BROADCOM is not set
# CONFIG_NET_VENDOR_EZCHIP is not set
# CONFIG_NET_VENDOR_HISILICON is not set
CONFIG_IXGBE=m
# CONFIG_NET_VENDOR_MARVELL is not set
# CONFIG_NET_VENDOR_MICREL is not set
# CONFIG_NET_VENDOR_MICROCHIP is not set
# CONFIG_NET_VENDOR_NATSEMI is not set
# CONFIG_NET_VENDOR_QUALCOMM is not set
# CONFIG_NET_VENDOR_RENESAS is not set
# CONFIG_NET_VENDOR_ROCKER is not set
# CONFIG_NET_VENDOR_SAMSUNG is not set
# CONFIG_NET_VENDOR_SEEQ is not set
# CONFIG_NET_VENDOR_SMSC is not set
# CONFIG_NET_VENDOR_STMICRO is not set
# CONFIG_NET_VENDOR_SYNOPSYS is not set
# CONFIG_NET_VENDOR_VIA is not set
# CONFIG_NET_VENDOR_WIZNET is not set
CONFIG_MICREL_PHY=m
CONFIG_REALTEK_PHY=m
CONFIG_INPUT_MOUSEDEV=y
CONFIG_INPUT_EVDEV=m
# CONFIG_KEYBOARD_ATKBD is not set
CONFIG_KEYBOARD_GPIO=m
# CONFIG_INPUT_MOUSE is not set
CONFIG_INPUT_MISC=y
CONFIG_INPUT_UINPUT=m
# CONFIG_SERIO is not set
CONFIG_VT_HW_CONSOLE_BINDING=y
# CONFIG_LEGACY_PTYS is not set
CONFIG_SERIAL_AMBARELLA=y
CONFIG_SERIAL_AMBARELLA_CONSOLE=y
# CONFIG_HW_RANDOM is not set
CONFIG_I2C=y
# CONFIG_I2C_COMPAT is not set
CONFIG_I2C_CHARDEV=m
CONFIG_I2C_MUX=y
CONFIG_I2C_MUX_GPIO=y
# CONFIG_I2C_HELPER_AUTO is not set
CONFIG_I2C_SMBUS=m
CONFIG_I2C_AMBARELLA=y
CONFIG_SPI=y
CONFIG_SPI_AMBARELLA=m
CONFIG_SPI_SPIDEV=m
# CONFIG_PTP_1588_CLOCK is not set
CONFIG_GPIOLIB=y
CONFIG_GPIO_PCA953X=y
CONFIG_GPIO_PCF857X=y
# CONFIG_HWMON is not set
CONFIG_WATCHDOG=y
CONFIG_WATCHDOG_CORE=y
CONFIG_MFD_SYSCON=y
CONFIG_RC_CORE=m
CONFIG_RC_DECODERS=y
CONFIG_IR_NEC_DECODER=m
CONFIG_IR_RC5_DECODER=m
CONFIG_IR_RC6_DECODER=m
CONFIG_IR_JVC_DECODER=m
CONFIG_IR_SONY_DECODER=m
CONFIG_IR_SANYO_DECODER=m
CONFIG_IR_SHARP_DECODER=m
CONFIG_IR_MCE_KBD_DECODER=m
CONFIG_IR_XMP_DECODER=m
CONFIG_RC_DEVICES=y
CONFIG_IR_AMBARELLA=m
CONFIG_MEDIA_SUPPORT=m
CONFIG_MEDIA_CAMERA_SUPPORT=y
CONFIG_FB=y
CONFIG_FB_AMBARELLA=m
CONFIG_LCD_CLASS_DEVICE=m
CONFIG_BACKLIGHT_CLASS_DEVICE=m
CONFIG_BACKLIGHT_PWM=m
CONFIG_SOUND=m
CONFIG_SND=m
# CONFIG_SND_SUPPORT_OLD_API is not set
# CONFIG_SND_DRIVERS is not set
# CONFIG_SND_SPI is not set
CONFIG_SND_SOC=m
CONFIG_SND_AMBARELLA_SOC=m
CONFIG_SND_AMBARELLA_CODEC=m
CONFIG_SND_SOC_AK4951_AMB=m
CONFIG_SND_SOC_NAU8810=m
CONFIG_SND_SOC_NAU8822=m
CONFIG_SND_SIMPLE_CARD=m
CONFIG_HID=m
CONFIG_USB=m
CONFIG_USB_ANNOUNCE_NEW_DEVICES=y
# CONFIG_USB_DEFAULT_PERSIST is not set
CONFIG_USB_XHCI_HCD=m
CONFIG_USB_XHCI_DBGCAP=y
CONFIG_USB_STORAGE=m
CONFIG_USB_CDNS_SUPPORT=m
CONFIG_USB_CDNS3=m
CONFIG_USB_CDNSP_GADGET=y
CONFIG_USB_CDNSP_HOST=y
CONFIG_USB_SERIAL=m
CONFIG_USB_SERIAL_GENERIC=y
CONFIG_USB_AMBARELLA_PHY=y
CONFIG_USB_GADGET=y
CONFIG_USB_GADGET_VBUS_DRAW=500
CONFIG_USB_AMBARELLA=m
CONFIG_USB_CONFIGFS=m
CONFIG_USB_CONFIGFS_F_UAC1=y
CONFIG_USB_CONFIGFS_F_UAC2=y
CONFIG_USB_CONFIGFS_F_UVC=y
CONFIG_USB_ETH=m
CONFIG_USB_MASS_STORAGE=m
CONFIG_USB_G_SERIAL=m
CONFIG_USB_AMB_STREAM=m
CONFIG_USB_G_MULTI=m
CONFIG_USB_G_WEBCAM=m
CONFIG_USB_G_AMB_WEBCAM=m
CONFIG_MMC=m
# CONFIG_PWRSEQ_EMMC is not set
# CONFIG_PWRSEQ_SIMPLE is not set
CONFIG_MMC_BLOCK_MINORS=32
CONFIG_MMC_AMBARELLA=m
CONFIG_MMC_SDHCI=m
CONFIG_MMC_SDHCI_PLTFM=m
CONFIG_MMC_SDHCI_AMBARELLA=m
CONFIG_RTC_CLASS=y
CONFIG_RTC_INTF_DEV_UIE_EMUL=y
CONFIG_RTC_DRV_ISL12022=m
CONFIG_RTC_DRV_AMBARELLA=m
CONFIG_DMADEVICES=y
CONFIG_AMBARELLA_DMA=y
CONFIG_AMBARELLA_CDNS_UDMA=y
# CONFIG_IOMMU_SUPPORT is not set
CONFIG_AMBARELLA_SUPPORT_GDMA=y
CONFIG_AMBARELLA_EXCALIBUR_RC=y
CONFIG_AMBARELLA_MOEMOEKYUN_RC=y
CONFIG_IIO=m
CONFIG_IIO_BUFFER_CB=m
CONFIG_IIO_SW_TRIGGER=m
CONFIG_AMBARELLA_ADC=m
CONFIG_AK8975=m
CONFIG_IIO_HRTIMER_TRIGGER=m
CONFIG_IIO_INTERRUPT_TRIGGER=m
CONFIG_IIO_SYSFS_TRIGGER=m
CONFIG_PWM=y
CONFIG_PWM_AMBARELLA=m
CONFIG_RESET_CONTROLLER=y
CONFIG_RESET_AMBA_CDNS_PHY=y
CONFIG_PHY_CADENCE_TORRENT=y
CONFIG_TEE=m
CONFIG_OPTEE=m
CONFIG_EXT4_FS=m
CONFIG_EXT4_FS_POSIX_ACL=y
CONFIG_EXT4_FS_SECURITY=y
# CONFIG_DNOTIFY is not set
CONFIG_FUSE_FS=m
CONFIG_CUSE=m
CONFIG_VFAT_FS=y
CONFIG_TMPFS=y
CONFIG_TMPFS_POSIX_ACL=y
CONFIG_HUGETLBFS=y
CONFIG_UBIFS_FS=y
CONFIG_UBIFS_FS_ADVANCED_COMPR=y
CONFIG_SQUASHFS=y
CONFIG_SQUASHFS_LZ4=y
CONFIG_SQUASHFS_LZO=y
CONFIG_SQUASHFS_XZ=y
CONFIG_NFS_FS=y
CONFIG_ROOT_NFS=y
CONFIG_NFSD=m
CONFIG_NFSD_V3=y
CONFIG_CIFS=y
# CONFIG_CIFS_STATS2 is not set
CONFIG_NLS_DEFAULT="utf8"
CONFIG_NLS_CODEPAGE_437=y
CONFIG_NLS_ISO8859_1=y
CONFIG_NLS_UTF8=y
CONFIG_LSM="lockdown,yama,loadpin,safesetid,integrity"
CONFIG_CRYPTO_SEQIV=y
CONFIG_CRYPTO_ECHAINIV=m
CONFIG_CRYPTO_CRC32C=y
CONFIG_CRYPTO_MD4=y
CONFIG_CRYPTO_DES=y
CONFIG_CRYPTO_ANSI_CPRNG=y
CONFIG_CRC_ITU_T=y
CONFIG_CRC7=y
CONFIG_DMA_CMA=y
CONFIG_PRINTK_TIME=y
CONFIG_DYNAMIC_DEBUG=y
CONFIG_DEBUG_SECTION_MISMATCH=y
CONFIG_DEBUG_FS=y
CONFIG_SAMPLES=y
CONFIG_SAMPLE_AMBARELLA_EXCALIBUR_EP=m
CONFIG_SAMPLE_AMBARELLA_EXCALIBUR_RC=m
CONFIG_SAMPLE_AMBARELLA_MOEMOEKYUN_EP=m
CONFIG_SAMPLE_AMBARELLA_MOEMOEKYUN_RC=m
# CONFIG_STRICT_DEVMEM is not set
```

## drivers/net/ethernet/ambarella/Kconfig
```kconfig
#
# AMBARELLA network device configuration
#

config NET_VENDOR_AMBARELLA
	tristate "Ambarella 10/100/1000 GMAC Ethernet support"
	depends on ARCH_AMBARELLA
	depends on PTP_1588_CLOCK_OPTIONAL
	select CRC32
	select PHYLIB
	select MII
	help
	  This driver supports Ambarella 10/100/1000 GMAC Ethernet.

config NET_VENDOR_AMBARELLA_INTEN_TUE
	bool "Enable Transmit Buffer Unavailable Interrupt"
	depends on NET_VENDOR_AMBARELLA
	default n
	help
	  Enable ETH_DMA_INTEN_TUE will downgrade the performance in most case,
	  but you will get a quick response especially in GMII mode.

	  If you are not sure, say N here.
```

## drivers/pci/endpoint/functions/Kconfig
```kconfig
# SPDX-License-Identifier: GPL-2.0
#
# PCI Endpoint Functions
#

config PCI_EPF_TEST
	tristate "PCI Endpoint Test driver"
	depends on PCI_ENDPOINT
	select CRC32
	help
	   Enable this configuration option to enable the test driver
	   for PCI Endpoint.

	   If in doubt, say "N" to disable Endpoint test driver.

config PCI_EPF_AMBA_TEST
	tristate "Ambarella's PCI Endpoint Test driver"
	depends on PCI_ENDPOINT
	select CRC32
	help
	   Enable this configuration option to enable the device
	   for PCI Endpoint.

	   If in doubt, say "N" to disable.

config PCI_EPF_NTB
	tristate "PCI Endpoint NTB driver"
	depends on PCI_ENDPOINT
	select CONFIGFS_FS
	help
	  Select this configuration option to enable the Non-Transparent
	  Bridge (NTB) driver for PCI Endpoint. NTB driver implements NTB
	  controller functionality using multiple PCIe endpoint instances.
	  It can support NTB endpoint function devices created using
	  device tree.

	  If in doubt, say "N" to disable Endpoint NTB driver.

config AMBARELLA_EXCALIBUR_EP
	depends on PCI && ARCH_AMBARELLA && PCI_ENDPOINT
	select CRC32
	bool "Ambarella EXCALIBUR EP driver"
	help
	   Enable this configuration option to enable the endpoint side driver
	   for Excalibur.

config AMBARELLA_MOEMOEKYUN_EP
	depends on PCI && ARCH_AMBARELLA && PCI_ENDPOINT
	bool "Ambarella MOEMOEKYUN EP driver"
	help
	   Enable this configuration option to enable the endpoint side driver
	   for MOEMOEKYUN.

config AMBARELLA_RAINY_EP
	depends on PCI && PCI_ENDPOINT
	bool "Ambarella Rainy EP driver"
	help
	   Enable this configuration option to enable the endpoint side driver
	   for RAINY.

config AMBARELLA_BSB_EP
	depends on PCI && PCI_ENDPOINT
	tristate "Ambarella BSB EP driver"
	help
	   Enable this configuration option to enable the endpoint side driver
	   for Bsb.
```

## drivers/rpmsg/ambarella/Kconfig
```kconfig
menu "Ambarella RPMSG"
config BLAZENET
	tristate "Blazenet driver"
	depends on ARCH_AMBARELLA
	depends on RPMSG
	depends on RPMSG_VIRTIO
	select RPMSG_SLAVE_BUS
	select RPMSG_AMBARELLA
	help
	  Say Y here to select blazenet driver. It's a virtual ethernet driver
	  based on RPMSG

config RPMSG_AMBARELLA
	tristate "Ambarella RPMSG driver"
	depends on RPMSG
	select VIRTIO

config RPMSG_SLAVE_NS
	tristate "RPMSG name service announcement for slave"
	depends on RPMSG
	help
	  Say Y here to enable the support of the name service announcement
	  in slave mode

config RPMSG_SLAVE_BUS
	tristate "Virtio RPMSG bus driver for slave"
	depends on RPMSG
	select RPMSG_SLAVE_NS
	select VIRTIO
endmenu
```

## drivers/soc/ambarella/Kconfig
```kconfig
#
# Ambarella SoC drivers
#

config AMBARELLA_SUPPORT_GDMA
	bool "Ambarella Enable GDMA"
        depends on ARCH_AMBARELLA
	default n
	help
	  Say y here to enable gdma

config AMBARELLA_LPDDR5_ADJUST
	bool "Ambarella adjust lpddr5 dynamically"
	depends on ARCH_AMBARELLA
	default n
	help
	  Say y here to adjust lpddr5 dynamically

config AMBARELLA_EXCALIBUR_RC
	depends on PCI && ARCH_AMBARELLA
	select CRC32
	bool "Ambarella EXCALIBUR RC driver"
	help
	   Enable this configuration option to enable the host side driver
	   for Excalibur.

config AMBARELLA_MOEMOEKYUN_RC
	depends on PCI && ARCH_AMBARELLA
	bool "Ambarella MOEMOEKYUN RC driver"
	help
	   Enable this configuration option to enable the host side driver
	   for Moemoekyun.

config AMBARELLA_NEKO_EP
	depends on PCI && ARCH_AMBARELLA
	tristate "Ambarella NEKO EP driver"
	help
	   Enable this configuration option to enable Neko.

config AMBARELLA_RAINY_RC
	depends on PCI
	tristate "Ambarella RAINY EP driver"
	help
	   Enable this configuration option to enable RAINY.

config AMBARELLA_BSB_RC
	depends on PCI
	bool "Ambarella BSB RC driver"
	help
	   Enable this configuration option to enable BSB.
```
